## boards/shields/keyboard_5_2/Kconfig.defconfig
```kconfig
if SHIELD_KEYBOARD_5_2_LEFT

config ZMK_KEYBOARD_NAME
    default "keyboard_5_2"

endif

if SHIELD_KEYBOARD_5_2_LEFT || SHIELD_KEYBOARD_5_2_RIGHT

config ZMK_SPLIT
    default y

endif
```

## boards/shields/keyboard_5_2/Kconfig.shield
```kconfig
config SHIELD_KEYBOARD_5_2_LEFT
    def_bool $(shields_list_contains,keyboard_5_2_left)
config SHIELD_KEYBOARD_5_2_RIGHT
    def_bool $(shields_list_contains,keyboard_5_2_right)
```
